## apps/ara/uart/Kconfig
```kconfig
#
# For a description of the syntax of this configuration file,
# see misc/tools/kconfig-language.txt.
#

config ARA_UART_TEST
	bool "Ara TSB UART Device Driver Test Program"
	default n
	depends on ARCH_CHIP_TSB && !GREYBUS_UART_PHY
	---help---
		Enable Toshiba UART low-level device driver test program.
        Note that this program does not exit.

if ARA_UART_TEST

config ARA_UART_TEST_PROGNAME
	string "Program name"
	default "uart_test"
	---help---
		This is the name of the program that will be use when the
		NSH ELF program is installed.

endif
```

## apps/ara/uart_test/Kconfig
```kconfig
#
# For a description of the syntax of this configuration file,
# see misc/tools/kconfig-language.txt.
#

config ARA_UART
	bool "Ara UART app"
	default y
	depends on ARCH_CHIP_TSB || ARCH_BOARD_ARA_SVC
	---help---
		Enable the Ara UART test program

if ARA_UART

config ARA_UART_PROGNAME
	string "Program name"
	default "uart_test"
	depends on BUILD_KERNEL
	---help---
		This is the name of the program that will be use when the NSH ELF
		program is installed.

endif
```
